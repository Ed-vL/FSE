## Trabalho_Final/esp32/main/Kconfig.projbuild
```kconfig
menu "Configuração do Wifi"

    config ESP_WIFI_SSID
        string "WiFi SSID"
        default "ssid"
        help
            Nome da rede Wifi.

    config ESP_WIFI_PASSWORD
        string "Senha do Wifi"
        default "minha_senha"
        help
            Senha do WiFi (WPA or WPA2).

    config ESP_MAXIMUM_RETRY
        int "Número máximo de tentativas de conexão"
        default 5
        help
            Configure o valor máximo de tentativas de conexão.
endmenu

menu "Configuração do Projeto"

    config MATRICULA_ID
        string "Matricula"
        default "170102343"
        help
            Matricula para topicos
    
    config ESP_MODE_BATTERY
        bool "ESP_MODE_BATTERY"
        default false
        help
            Selecione para executar no modo bateria
endmenu
```
